/* Intro-style layout: minimal sections, no page padding between them.
   Program headers are generated by ld automatically (PT_INTERP/PT_DYNAMIC/
   PT_GNU_STACK/PT_LOAD), so the first LOAD covers the ELF headers. */
ENTRY(_start)

SECTIONS
{
    . = 0x400000 + SIZEOF_HEADERS;

    .interp     : { *(.interp) }
    .gnu.hash   : { *(.gnu.hash) }
    .dynsym     : { *(.dynsym) }
    .dynstr     : { *(.dynstr) }
    .rela.plt   : { *(.rela.plt) }
    .rela.dyn   : { *(.rela.dyn) *(.rela) }
    .plt        : { *(.plt) *(.plt.*) }
    .text       : { *(.text.unlikely .text.*) *(.text) }
    .rodata     : { *(.rodata .rodata.*) }
    .eh_frame   : { KEEP(*(.eh_frame .eh_frame.*)) }
    .dynamic    : { *(.dynamic) }
    .got        : { *(.got .got.plt) }
    .data       : { *(.data .data.*) }
    .bss        : { *(.bss .bss.* COMMON) }

    /DISCARD/ : {
        *(.comment)
        *(.note .note.*)
        *(.gcc_except_table .gcc_except_table.*)
        *(.symtab .strtab)
    }
}
